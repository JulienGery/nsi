#define LEDVERTE 2

const String morse[][2] = {
      {"a", ".-" },
      {"b", "-..." },
      {"c", "-.-." },
      {"d", "-.."},
      {"e", "."},
      {"f", "..-."},
      {"g", "--."},
      {"h", "...."},
      {"i", ".."},
      {"j", ".---"},
      {"k", "-.-"},
      {"l", ".-.."},
      {"m", "--"},
      {"n", "-."},
      {"o", "---"},
      {"p", ".--."},
      {"q", "--.-"},
      {"r", ".-."},
      {"s", "..."},
      {"t", "-"},
      {"u", "..-"},
      {"v", "...-"},
      {"w", ".--"},
      {"x", "-..-"},
      {"y", "-.--"},
      {"z", "--.."},
      {"0", "-----"},
      {"1", ".----"},
      {"2", "..---"},
      {"3", "...--"},
      {"4", "....-"},
      {"5", "....."},
      {"6", "-...."},
      {"7", "--..."},
      {"8", "---.."},
      {"9", "----."},
      {" ", "·······"},
      {"!", "-.-.--"},
      {"?", "..--.."},
      {".", ".-.-.-"},
      {",", "--..--"}
};


void setup() {
  Serial.begin(115200);
  pinMode(LEDVERTE, OUTPUT);
}
void loop() {
  String message = "hello";
  for(auto &i: message){
    for(auto &j: morse){
      if(j[0] == String(i)){
        for(auto &h : j[1]){
          digitalWrite(LEDVERTE, HIGH);
          h == '-'? delay(2000): delay(500);
          digitalWrite(2, LOW);
          delay(200);
        }
      }
    }
  }
}